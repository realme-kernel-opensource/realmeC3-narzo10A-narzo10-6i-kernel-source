## drivers/input/touchscreen/oppo_touchscreen/Goodix/Kconfig
```kconfig
source "drivers/input/touchscreen/oppo_touchscreen/Goodix/Goodix_gt5688/Kconfig"
source "drivers/input/touchscreen/oppo_touchscreen/Goodix/GT9286/Kconfig"
```

## drivers/input/touchscreen/oppo_touchscreen/Himax/Kconfig
```kconfig
source "drivers/input/touchscreen/oppo_touchscreen/Himax/hx83112b/Kconfig"
source "drivers/input/touchscreen/oppo_touchscreen/Himax/hx83112a_noflash/Kconfig"
source "drivers/input/touchscreen/oppo_touchscreen/Himax/hx83112b_noflash/Kconfig"
source "drivers/input/touchscreen/oppo_touchscreen/Himax/hx83102d_noflash/Kconfig"
```

## drivers/input/touchscreen/oppo_touchscreen/Himax/hx83102d_noflash/Kconfig
```kconfig
#ifdef VENDOR_EDIT
#Added by ZhangPing@Bsp.group.Tp for himax hx83102D NOFLASH ic driver

config TOUCHPANEL_HIMAX_HX83102D_NOFLASH
#	default y
	bool "TP himax hx83102d no-flash IC enable or not for OPPO"
	---help---
	say Y to enable driver for Touchpanel useing himax hx83102d no-flash

#endif
```

## drivers/input/touchscreen/oppo_touchscreen/Himax/hx83112a_noflash/Kconfig
```kconfig
#ifdef VENDOR_EDIT
#Added by ZhongWenjie@Bsp.group.Tp for himax hx833112A NOFLASH ic driver

config TOUCHPANEL_HIMAX_HX83112A_NOFLASH
#	default y
	bool "TP himax hx83112a no-flash IC enable or not for OPPO"
	---help---
	say Y to enable driver for Touchpanel useing himax hx83112a no-flash

#endif
```

## drivers/input/touchscreen/oppo_touchscreen/Himax/hx83112b_noflash/Kconfig
```kconfig
#ifdef VENDOR_EDIT
#Added by ZhongWenjie@Bsp.group.Tp for himax hx833112B NOFLASH ic driver

config TOUCHPANEL_HIMAX_HX83112B_NOFLASH
#	default y
	bool "TP himax hx83112b no-flash IC enable or not for OPPO"
	---help---
	say Y to enable driver for Touchpanel useing himax hx83112b no-flash

#endif
```

## drivers/input/touchscreen/oppo_touchscreen/Novatek/Kconfig
```kconfig
source "drivers/input/touchscreen/oppo_touchscreen/Novatek/NT36672/Kconfig"
source "drivers/input/touchscreen/oppo_touchscreen/Novatek/NT36525/Kconfig"
source "drivers/input/touchscreen/oppo_touchscreen/Novatek/NT36672_noflash/Kconfig"
source "drivers/input/touchscreen/oppo_touchscreen/Novatek/NT36525_noflash/Kconfig"
source "drivers/input/touchscreen/oppo_touchscreen/Novatek/NT36525B_noflash/Kconfig"
```

## drivers/input/touchscreen/oppo_touchscreen/Samsung/Kconfig
```kconfig
source "drivers/input/touchscreen/oppo_touchscreen/Samsung/S6SY761/Kconfig"
source "drivers/input/touchscreen/oppo_touchscreen/Samsung/S6D7AT0/Kconfig"
```

## drivers/input/touchscreen/oppo_touchscreen/Samsung/S6D7AT0/Kconfig
```kconfig
#ifdef VENDOR_EDIT
#Added by Kun.Wang@Bsp.group.Tp for Samsung s6d7at0 ic driver

config TOUCHPANEL_SAMSUNG_S6D7AT0
#	default y
	bool "TP Samsung s6sy761 IC enable or not for OPPO"
	---help---
	say Y to enable driver for Touchpanel using Samsung s6d7at0

#endif
```

## drivers/input/touchscreen/oppo_touchscreen/ilitek/Kconfig
```kconfig
source "drivers/input/touchscreen/oppo_touchscreen/ilitek/ilitek9881h/Kconfig"
source "drivers/input/touchscreen/oppo_touchscreen/ilitek/ilitek9881h_v2/Kconfig"
source "drivers/input/touchscreen/oppo_touchscreen/ilitek/ilitek9881h_v3/Kconfig"
```

## drivers/input/touchscreen/oppo_touchscreen/ilitek/ilitek9881h/Kconfig
```kconfig
#ifdef VENDOR_EDIT
#Added by MingQiang.Guo@Bsp.group.Tp for ilitek ilitek9881h ic driver

config TOUCHPANEL_ILITEK_ILITEK9881H
#	default y
	bool "TP ilitek ilitek9881h IC enable or not for  OPPO"
	---help---
	say Y to enable driver for Touchpanel using ilitek ilitek9881h

#endif
```

## drivers/input/touchscreen/oppo_touchscreen/ilitek/ilitek9881h_v2/Kconfig
```kconfig
#ifdef VENDOR_EDIT
#Added by guqicai@Bsp.group.Tp for ilitek ilitek9881h ic driver

config TOUCHPANEL_ILITEK_ILITEK9881H_V2
#	default y
	bool "TP ilitek ilitek9881h IC enable or not for OPPO"
	---help---
	say Y to enable driver for Touchpanel using ilitek ilitek9881h

#endif
```

## drivers/misc/mediatek/sensors-1.0/sensorfusion/action_detecthub/Kconfig
```kconfig
config MTK_ACTION_DETECTHUB
	bool "action_detecthub for MediaTek package"
	default n
```

## drivers/misc/mediatek/sensors-1.0/sensorfusion/pickup_motionhub/Kconfig
```kconfig
config MTK_PICKUP_MOTIONHUB
	bool "pickup_motionhub for MediaTek package"
	default n
```

## drivers/qihoo/Kconfig
```kconfig
menuconfig QIHOO
	tristate "qihoo kernel hotfix patch"
	default y
	select ARM64_MODULE_CMODEL_LARGE if ARM64_ERRATUM_843419
	help
	This is the kernel hotfix patch

if QIHOO

config QIHOO_KERNEL_CHECK
	tristate "check kernel build timestamps and kernel version"
	default y
	help
	  Say Y here to enable check kernel version and build time.

config QIHOO_SIGN_CHECK
	tristate "check patch sign info when load patch"
	default y
	help
	  Say Y here to enable check patch signature.

config QIHOO_USE_KERNEL_FRAME
	tristate "use kernel frame code for patch load"
	default y
	help
	  Say Y here to enable use kernel frame code.

endif # QIHOO
```

## drivers/soc/oppo/Kconfig
```kconfig
#ifdef VENDOR_EDIT
# Bin.Li@EXP.BSP.bootloader.bootflow, 2017/05/15, Add for config oppo  software common soft
config OPPO_ARCH_FILE
    bool "for build directory oppo"
    ---help---
    say Y to buid in

config OPPO_COMMON_SOFT
        bool "config oppo common software"
        select OPPO_ARCH_FILE
        help
        define this config to get project verion from sharemem.
        Maybe this value is from CDT or dynamic identify by hardware
        id.

config OPPO_DEVICE_IFNO
        bool "config oppo devinfo"
        select OPPO_ARCH_FILE
        help
        define this config to compile devinfo.c for device register.

source "drivers/soc/oppo/oppo_project/Kconfig"
source "drivers/soc/oppo/oppo_devinfo/Kconfig"

source "drivers/soc/oppo/oppo_hypnus/Kconfig"
#ifdef VENDOR_EDIT
#//wenbin.liu@PSW.Kernel.MM, 2018/05/23, Add for Healthinfo monitor
source "drivers/soc/oppo/oppo_healthinfo/Kconfig"
#endif /* VENDOR_EDIT */
#//Wen.Luo@BSP
#Liang.Zhang@TECH.Storage.Stability.OPPO_SHUTDOWN_DETECT, 2019/04/28, Add for shutdown detect
source "drivers/soc/oppo/oppo_shutdown_detect/Kconfig"

#Kun.Hu@TECH.BSP.Stability.PHOENIX_PROJECT 2019/06/15, Add for PHOENIX_PROJECT
source "drivers/soc/oppo/oppo_phoenix/Kconfig"
#endif /* VENDOR_EDIT */
```

## drivers/soc/oppo/oppo_criticallog/Kconfig
```kconfig
#ifdef VENDOR_EDIT
#//John.Xu@PhoneSw.AudioDriver.OppoDebug.CriticalLog, 2016/02/22, Add for critical_log
config OPPO_CRITICALLOG
	bool "config oppo critical log"
	default y
	help
            define this config to init oppo critical log driver.
#endif /* VENDOR_EDIT */
```

## drivers/soc/oppo/oppo_dump/Kconfig
```kconfig
config OPPO_FORCE_DUMP
	bool "config oppo force dump"
	help
		define force dump functions
```

## drivers/soc/oppo/oppo_healthinfo/Kconfig
```kconfig
#ifdef VENDOR_EDIT
#//wenbin.liu@PSW.Kernel.MM, 2018/05/23, Add for Healthinfo monitor
config OPPO_HEALTHINFO
bool "config oppo healthinfo"
help
    define this config to init oppo healthinfo.
#endif /* VENDOR_EDIT */
```

## drivers/soc/oppo/oppo_phoenix/Kconfig
```kconfig
#Kun.Hu@TECH.BSP.Stability.PHOENIX_PROJECT 2019/06/15, Add for PHOENIX_PROJECT
#change 'y' to 'n', if you want fo close phoenix feature
config OPPO_PHOENIX
    bool "oppo phoenix project"
    default y
    help
      define this config to init oppo phoenix project.
```

## drivers/soc/oppo/oppo_shutdown_detect/Kconfig
```kconfig
#ifdef VENDOR_EDIT
#Wen.Luo@PSW.Kernel.Stability, 2018/05/23, Add for oppo_shutdown_detect monitor
#Liang.Zhang@TECH.Storage.Stability.OPPO_SHUTDOWN_DETECT, 2019/04/28, Add for shutdown detect
config OPPO_SHUTDOWN_DETECT
        bool "OPPO shutdown hang detect"
        default y
        help
            define this config to init oppo oppo_shutdown_detect.
#endif /* VENDOR_EDIT */
```

## kernel/Kconfig.freezer
```kconfig
config FREEZER
	def_bool PM_SLEEP || CGROUP_FREEZER

#ifdef VENDOR_EDIT
#zhoumingjun@Swdp.shanghai, 20117/07/13, add config for elsa stubs
config ELSA_STUB
	bool "Enable ELSA stub in kernel"
	default n
#endif
```
