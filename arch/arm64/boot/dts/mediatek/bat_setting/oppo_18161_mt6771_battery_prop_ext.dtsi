/*******************************************************************************
** File: oppo_18161_mt6771_battery_prop_ext.dtsi
** Copyright (C), 2008-2019, OPPO Mobile Comm Corp, Ltd
** Description: 18161 battery model
** Version: 1.0
** Date created: 2019-02-20
** Author: Yichun.Chen PSW.BSP.CHG
**
** --------------------------- Revision History: -------------------------------
** version     <author>          <data>                     <desc>
**   1.0      Yichun.Chen      2019-02-20        create for 18161 battery model
********************************************************************************/

bat_gm30: bat_gm30{
	compatible = "mediatek,bat_gm30";
	DIFFERENCE_FULLOCV_ITH = <(350)>;/*	Charging termination current.*/
	SHUTDOWN_1_TIME = <(60)>;	/*	If ui_soc shows 1% more than X minites, system will shutdown.*/
	KEEP_100_PERCENT = <(3)>;	/*	The ui_soc will keep 100% until SOC drop X percents after unplugged.*/
	R_FG_VALUE = <(10)>;	/*	R_sense resistance.*/
	EMBEDDED_SEL = <(1)>;	/*	Configures whether using embedded battery or not.*/
	PMIC_SHUTDOWN_CURRENT = <(20)>;	/*	System shutdown current.*/
	FG_METER_RESISTANCE = <(50)>;	/*	The resistance of PCB*/
	CAR_TUNE_VALUE = <(100)>;	/*	Tune value for current measurement.*/
	PMIC_MIN_VOL = <(34300)>;	/*	vboot voltage for gauge 0%.*/
	POWERON_SYSTEM_IBOOT = <(500)>;	/*	power on system iboot*/
	SHUTDOWN_GAUGE0_VOLTAGE = <(34000)>;	/*	shutdown gauge 0% voltage*/
	TEMPERATURE_T0 = <(50)>;	/*	Battery temperature T0*/
	TEMPERATURE_T1 = <(25)>;	/*	Battery temperature T1*/
	TEMPERATURE_T2 = <(10)>;	/*	Battery temperature T2*/
	TEMPERATURE_T3 = <(0)>;	/*	Battery temperature T3*/
	TEMPERATURE_T4 = <(-10)>;	/*	Battery temperature T4*/
	g_FG_PSEUDO100_T0 = <(100)>;	/*	Pseudo 100% percentage at T0.*/
	g_FG_PSEUDO100_T1 = <(97)>;	/*	Pseudo 100% percentage at T1.*/
	g_FG_PSEUDO100_T2 = <(95)>;	/*	Pseudo 100% percentage at T2.*/
	g_FG_PSEUDO100_T3 = <(92)>;	/*	Pseudo 100% percentage at T3.*/
	g_FG_PSEUDO100_T4 = <(90)>;	/*	Pseudo 100% percentage at T4.*/
	g_FG_PSEUDO1_T0 = <(0)>;	/*	Pseudo 100% percentage at T0.*/
	g_FG_PSEUDO1_T1 = <(0)>;	/*	Pseudo 100% percentage at T1.*/
	g_FG_PSEUDO1_T2 = <(0)>;	/*	Pseudo 100% percentage at T2.*/
	g_FG_PSEUDO1_T3 = <(0)>;	/*	Pseudo 100% percentage at T3.*/
	g_FG_PSEUDO1_T4 = <(0)>;	/*	Pseudo 100% percentage at T4.*/
	Q_MAX_SYS_VOLTAGE_BAT0 = <(3350)>;	/*	System shut down voltage.*/
	Q_MAX_SYS_VOLTAGE_BAT1 = <(3350)>;	/*	System shut down voltage.*/
	Q_MAX_SYS_VOLTAGE_BAT2 = <(3350)>;	/*	System shut down voltage.*/
	Q_MAX_SYS_VOLTAGE_BAT3 = <(3350)>;	/*	System shut down voltage.*/

	#include "oppo_18161_mt6771_battery_table_ext.dtsi"
};
